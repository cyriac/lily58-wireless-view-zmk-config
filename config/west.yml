## config/west.yml
```yaml
manifest:
  remotes:
    - name: zmkfirmware
      url-base: https://github.com/zmkfirmware
    - name: zmk
      url-base: https://github.com/petejohanson
  projects:
    - name: zmk
      remote: zmk
      revision: feat/pointers-move-scroll
      import: app/west.yml
  self:
    path: config
```
